## config/west.yml
```yaml
manifest:
  remotes:
    - name: zmkfirmware
      url-base: https://github.com/petejohanson
    - name: inorichi
      url-base: https://github.com/inorichi
  projects:
    - name: zmk
      remote: zmkfirmware
      # revision: feat/pointers-move-scroll
      revision: 7e7214237d032c8eec0e1cf326a0b4fbe2cba34d # fix(mouse): Fixes for logging.
      import: app/west.yml
    - name: zmk-pmw3610-driver
      remote: inorichi
      revision: main
  self:
    path: config
```
